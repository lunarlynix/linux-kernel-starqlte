// SPDX-License-Identifier: GPL-2.0
/*
 * SDM845 Samsung S9 (SM-G9600) (starqltechn) specific device tree
 *
 * Copyright (c) 2020, The Linux Foundation. All rights reserved.
 */

#include "sdm845-samsung-starqltechn.dtsi"

/ {
	model = "Samsung S9 Mainline";
	compatible = "qcom,sdm845-mtp", "qcom,sdm845", "qcom,mtp";

	chosen {
		#address-cells = <2>;
        #size-cells = <2>;
        ranges;
		bootargs = "initcall_debug=1  loglevel=15 clk_ignore_unused";
	};


	reserved-memory {
	    ramoops@A1300000 {
            compatible = "ramoops";
            reg = <0x0 0xa1300000 0x0 0x100000>;
            record-size = <0x40000>;
            console-size = <0x40000>;
            ftrace-size = <0x40000>;
            pmsg-size = <0x40000>;
        };
	};
};